## lib/pdn_management/Kconfig
```kconfig
#
# Copyright (c) 2019 Nordic Semiconductor
#
# SPDX-License-Identifier: LicenseRef-BSD-5-Clause-Nordic
#

menuconfig PDN_MANAGEMENT
	bool "PDN Management for nRF9160"
	select BSD_LIBRARY

if PDN_MANAGEMENT
endif # PDN_MANAGEMENT
```
